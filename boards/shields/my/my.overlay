#include <dt-bindings/zmk/matrix_transform.h>

/ {
    chosen {
        zmk,kscan = &default_kscan;
    };

    default_kscan: kscan {
        compatible = "zmk,kscan-gpio-direct";
        input-gpios = <&pro_micro 5  (GPIO_ACTIVE_LOW | GPIO_PULL_UP)>,
                      <&pro_micro 20 (GPIO_ACTIVE_LOW | GPIO_PULL_UP)>,
                      <&pro_micro 21 (GPIO_ACTIVE_LOW | GPIO_PULL_UP)>;
    };
};
